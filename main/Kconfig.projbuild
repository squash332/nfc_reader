## main/Kconfig.projbuild
```kconfig
menu "WiFi Configuration"

    config WIFI_SSID
        string "WiFi SSID"
        default ""
        help
            SSID of the WiFi network to connect to.

    config WIFI_PASSWORD
        string "WiFi Password"
        default ""
        help
            Password of the WiFi network.

    config BASE_URL
        string "Backend Base URL"
        default "http://10.138.208.121:8000"
        help
            Base URL of the backend server (e.g. http://10.138.208.121:8000).

endmenu
```
